## conf/layer.conf
```bitbake
# We have a conf and classes directory, add to BBPATH
BBPATH .= ":${LAYERDIR}"

# We have a packages directory, add to BBFILES
BBFILES += "${LAYERDIR}/recipes-*/*/*.bb"
BBFILES += "${LAYERDIR}/recipes-*/*/*.bbappend"

BBFILE_COLLECTIONS += "imx8mmevkimxextra"
BBFILE_PATTERN_imx8mmevkimxextra = "^${LAYERDIR}/"
BBFILE_PRIORITY_imx8mmevkimxextra = "5"

LAYERDEPENDS_imx8mmevkimxextra = "core imx8mmevkbsp"
LAYERSERIES_COMPAT_imx8mmevkimxextra = "dunfell kirkstone"

BBFILES_DYNAMIC += " \
	core:${LAYERDIR}/dynamic-layers/core/*/*/*.bb \
	core:${LAYERDIR}/dynamic-layers/core/*/*/*.bbappend \
	\
	openembedded-layer:${LAYERDIR}/dynamic-layers/openembedded-layer/*/*/*.bb \
	openembedded-layer:${LAYERDIR}/dynamic-layers/openembedded-layer/*/*/*.bbappend \
	"
```
